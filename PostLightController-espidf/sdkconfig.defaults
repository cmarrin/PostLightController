## PostLightController-espidf/sdkconfig.defaults
```kconfig
CONFIG_ESP_SYSTEM_PANIC_PRINT_HALT=y
CONFIG_LWIP_MAX_SOCKETS=20
CONFIG_ESP_SYSTEM_EVENT_TASK_STACK_SIZE=4096
CONFIG_ESP_MAIN_TASK_STACK_SIZE=4096
CONFIG_ESP_TIMER_TASK_STACK_SIZE=3184
CONFIG_PTHREAD_TASK_STACK_SIZE_DEFAULT=8192

#
# Blink LED Configuration
#
CONFIG_BLINK_LED_GPIO=y
# CONFIG_BLINK_LED_STRIP is not set
# CONFIG_BLINK_LED_GPIO_ACTIVE_LOW is not set
CONFIG_BLINK_LED_GPIO_ACTIVE_HIGH=y
CONFIG_BLINK_LED_GPIO_NUMBER=8
# end of Blink LED Configuration
```

## espidf/sdkconfig.defaults
```kconfig
CONFIG_ESP_SYSTEM_PANIC_PRINT_HALT=y
CONFIG_LWIP_MAX_SOCKETS=20
CONFIG_ESP_SYSTEM_EVENT_TASK_STACK_SIZE=4096
CONFIG_ESP_MAIN_TASK_STACK_SIZE=4096
CONFIG_ESP_TIMER_TASK_STACK_SIZE=3184
CONFIG_PTHREAD_TASK_STACK_SIZE_DEFAULT=8192
```
